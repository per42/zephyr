#include <st/wl/stm32wl.dtsi>

/ {
	cpus {
		// #address-cells = <1>;
		// #size-cells = <0>;

		// cpu0: cpu@0 {
		// 	device_type = "cpu";
		// 	compatible = "arm,cortex-m4";
		// 	reg = <0>;
		// 	cpu-power-states = <&stop0 &stop1 &stop2>;
		// };

		cpu1: cpu@1 {
			compatible = "arm,cortex-m0+";
			reg = <1>;
		};
	};
};
